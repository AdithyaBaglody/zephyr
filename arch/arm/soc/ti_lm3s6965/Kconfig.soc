## arch/arm/soc/ti_lm3s6965/Kconfig.soc
```kconfig
config SOC_TI_LM3S6965
	bool "TI LM3S6965"
	select CPU_CORTEX_M3
	select CPU_HAS_SYSTICK
	select CPU_HAS_MPU
	select	MPU_REQUIRES_POWER_OF_TWO_ALIGNMENT
```

## boards/arm/qemu_cortex_m3/qemu_cortex_m3_defconfig
```kconfig
CONFIG_ARM=y
CONFIG_SYS_CLOCK_HW_CYCLES_PER_SEC=12000000
CONFIG_SOC_TI_LM3S6965=y
CONFIG_BOARD_QEMU_CORTEX_M3=y
CONFIG_CONSOLE=y
CONFIG_UART_CONSOLE=y
CONFIG_SERIAL=y
CONFIG_CORTEX_M_SYSTICK=y
CONFIG_UART_STELLARIS=y
CONFIG_HAS_USERSPACE=y
CONFIG_ARM_MPU_ENABLE=y
CONFIG_ARM_CORE_MPU=y
CONFIG_MPU_REQUIRES_POWER_OF_TWO_ALIGNMENT=y
```

## tests/benchmarks/sys_kernel/testcase.yaml
```yaml
tests:
  benchmark.kernel:
    arch_exclude: nios2 riscv32 xtensa
    min_ram: 32
    tags: benchmark
  benchmark.kernel.qemu_cortex_m3:
    platform_whitelist: qemu_cortex_m3
    extra_args: CONF_FILE=prj_qemu_cortex_m3.conf
    tags: benchmark qemu_cortex_m3
```

## tests/kernel/mem_protect/mpu/testcase.yaml
```yaml
tests:
  test:
    filter: CONFIG_USERSPACE
    tags: core security userspace ignore_faults
```
